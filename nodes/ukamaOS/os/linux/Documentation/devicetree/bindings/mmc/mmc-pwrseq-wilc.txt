## nodes/ukamaOS/os/linux/Documentation/devicetree/bindings/mmc/mmc-pwrseq-wilc.txt
```
* Microchip WILC power sequence provider

Required properties:
- compatible: must be "mmc-pwrseq-wilc".
- powerdown-gpios: contains a power down GPIO specifier with the
		   default active state
- reset-gpios: contains a reset GPIO specifier with the default
		   active state

Example:

	wifi_pwrseq: wifi_pwrseq {
		compatible = "mmc-pwrseq-wilc";
		powerdown-gpios = <&pioA 29 GPIO_ACTIVE_HIGH>;
		reset-gpios = <&pioA 29 GPIO_ACTIVE_HIGH>;
		status = "okay";
	}
```

## ukamaOS/firmware/at91bootstrap/board/at91sam9261ek/at91sam9261eknf_linux_image_defconfig
```kconfig
CONFIG_AT91SAM9261EK=y
CONFIG_NANDFLASH=y
CONFIG_LOAD_LINUX=y
# CONFIG_OF_LIBFDT is not set
CONFIG_DEBUG=y
CONFIG_THUMB=y
```

## ukamaOS/firmware/at91bootstrap/board/at91sam9g10ek/at91sam9g10ekdf_linux_image_defconfig
```kconfig
CONFIG_AT91SAM9G10EK=y
CONFIG_CPU_CLK_266MHZ=y
CONFIG_LOAD_LINUX=y
# CONFIG_OF_LIBFDT is not set
CONFIG_DEBUG=y
CONFIG_THUMB=y
```

## ukamaOS/firmware/at91bootstrap/board/sam9x60_ddr2_sip_eb/sam9x60_ddr2_sip_ebdf_qspi_uboot_defconfig
```kconfig
CONFIG_SAM9X60_DDR2_SIP_EB=y
CONFIG_RAM_128MB=y
CONFIG_SPI_CLK=50000000
CONFIG_IMG_ADDRESS="0x00040000"
CONFIG_IMG_SIZE="0x000c0000"
CONFIG_DEBUG=y
```

## ukamaOS/firmware/at91bootstrap/board/sam9x60_ddr2_sip_eb/sam9x60_ddr2_sip_ebsd_uboot_defconfig
```kconfig
CONFIG_SAM9X60_DDR2_SIP_EB=y
CONFIG_RAM_128MB=y
CONFIG_SDCARD=y
CONFIG_DEBUG=y
CONFIG_THUMB=y
```

## ukamaOS/firmware/at91bootstrap/board/sam9x60ek/sam9x60ekdf_qspi_uboot_defconfig
```kconfig
CONFIG_SAM9X60EK=y
CONFIG_RAM_256MB=y
CONFIG_SPI_CLK=50000000
CONFIG_IMG_ADDRESS="0x00040000"
CONFIG_IMG_SIZE="0x000c0000"
CONFIG_DEBUG=y
```

## ukamaOS/firmware/at91bootstrap/board/sama5d2_icp/sama5d2_icpsd_uboot_defconfig
```kconfig
CONFIG_SAMA5D2_ICP=y
CONFIG_MCK_BYPASS=y
CONFIG_CPU_CLK_498MHZ=y
CONFIG_RAM_512MB=y
CONFIG_DDR3=y
CONFIG_SDCARD=y
CONFIG_DEBUG=y
# CONFIG_ENTER_NWD is not set
CONFIG_EEPROM_ON_TWI1=y
# CONFIG_AUTOCONFIG_TWI_BUS is not set
```

## ukamaOS/firmware/at91bootstrap/board/sama5d2_ptc_ek/sama5d2_ptc_eksd_uboot_defconfig
```kconfig
CONFIG_SAMA5D2_PTC_EK=y
CONFIG_RAM_512MB=y
CONFIG_DDR2=y
CONFIG_SDCARD=y
CONFIG_SDHC0=y
CONFIG_DEBUG=y
# CONFIG_ENTER_NWD is not set
```

## ukamaOS/firmware/at91bootstrap/board/sama5d3_xplained/sama5d3_xplainednf_linux_image_dt_defconfig
```kconfig
CONFIG_SAMA5D3_XPLAINED=y
CONFIG_CPU_CLK_528MHZ=y
CONFIG_RAM_256MB=y
# CONFIG_PMECC_AUTO_DETECT is not set
CONFIG_PMECC_CORRECT_BITS_4=y
CONFIG_LOAD_LINUX=y
CONFIG_OVERRIDE_CMDLINE=y
CONFIG_DEBUG=y
```

## ukamaOS/firmware/at91bootstrap/board/sama5d3_xplained/sama5d3_xplainednf_uboot_defconfig
```kconfig
CONFIG_SAMA5D3_XPLAINED=y
CONFIG_CPU_CLK_528MHZ=y
CONFIG_RAM_256MB=y
# CONFIG_PMECC_AUTO_DETECT is not set
CONFIG_PMECC_CORRECT_BITS_4=y
CONFIG_IMG_SIZE="0x000c0000"
CONFIG_DEBUG=y
```

## ukamaOS/firmware/at91bootstrap/board/sama7g5ek/sama7g5eksd_uboot_defconfig
```kconfig
CONFIG_SAMA7G5EK=y
CONFIG_CPU_CLK_1000MHZ=y
CONFIG_RAM_512MB=y
CONFIG_SDHC1=y
CONFIG_JUMP_ADDR="0x66f00000"
CONFIG_DEBUG=y
# CONFIG_MATRIX is not set
# CONFIG_ENTER_NWD is not set
# CONFIG_REDIRECT_ALL_INTS_AIC is not set
CONFIG_TZC400=y
CONFIG_MCP16502=y
CONFIG_WDTS=y
```

## ukamaOS/firmware/at91bootstrap/contrib/board/acme/sama5d2_roadrunner/sama5d2_roadrunner_defconfig
```kconfig
CONFIG_SAMA5D2_ROADRUNNER=y
CONFIG_RAM_256MB=y
CONFIG_DDR3=y
CONFIG_SDCARD=y
CONFIG_SDHC1=y
CONFIG_LOAD_LINUX=y
CONFIG_OVERRIDE_CMDLINE=y
CONFIG_LINUX_KERNEL_ARG_STRING="mem=256M console=ttyS0,115200 root=/dev/mmcblk0p2 rootfstype=ext4 rw rootwait consoleblank=0"
CONFIG_IMAGE_NAME="zImage"
CONFIG_DEBUG=y
# CONFIG_ENTER_NWD is not set
# CONFIG_DISABLE_ACT8865_I2C is not set
# CONFIG_LOAD_EEPROM is not set
```
