## nodes/ukamaOS/firmware/at91bootstrap/board/at91sam9g20ek/at91sam9g20eknf_linux_image_dt_defconfig
```kconfig
CONFIG_AT91SAM9G20EK=y
CONFIG_NANDFLASH=y
CONFIG_LOAD_LINUX=y
CONFIG_DEBUG=y
CONFIG_THUMB=y
```

## nodes/ukamaOS/firmware/at91bootstrap/board/at91sam9m10g45ek/at91sam9m10g45ekdf_linux_image_dt_defconfig
```kconfig
CONFIG_AT91SAM9M10G45EK=y
CONFIG_LOAD_LINUX=y
CONFIG_LINUX_KERNEL_ARG_STRING="mem=64M console=ttyS0,115200 mtdparts=atmel_nand:8M(bootstrap/kernel),60M(rootfs),-(spare) root=/dev/mtdblock1 rw rootfstype=jffs2"
CONFIG_DEBUG=y
CONFIG_THUMB=y
CONFIG_SCLK=y
```

## nodes/ukamaOS/firmware/at91bootstrap/board/at91sam9m10g45ek/at91sam9m10g45eksd_uboot_defconfig
```kconfig
CONFIG_AT91SAM9M10G45EK=y
CONFIG_SDCARD=y
CONFIG_DEBUG=y
CONFIG_THUMB=y
CONFIG_SCLK=y
```

## nodes/ukamaOS/firmware/at91bootstrap/board/at91sam9n12ek/at91sam9n12ekdf_uboot_defconfig
```kconfig
CONFIG_AT91SAM9N12EK=y
CONFIG_RAM_128MB=y
CONFIG_DEBUG=y
CONFIG_THUMB=y
CONFIG_SCLK=y
```

## nodes/ukamaOS/firmware/at91bootstrap/board/at91sam9n12ek/at91sam9n12eknf_uboot_defconfig
```kconfig
CONFIG_AT91SAM9N12EK=y
CONFIG_RAM_128MB=y
CONFIG_NANDFLASH=y
# CONFIG_PMECC_AUTO_DETECT is not set
CONFIG_DEBUG=y
CONFIG_THUMB=y
CONFIG_SCLK=y
```

## nodes/ukamaOS/firmware/at91bootstrap/board/at91sam9rlek/at91sam9rleknf_linux_image_defconfig
```kconfig
CONFIG_AT91SAM9RLEK=y
CONFIG_NANDFLASH=y
CONFIG_LOAD_LINUX=y
# CONFIG_OF_LIBFDT is not set
CONFIG_DEBUG=y
CONFIG_THUMB=y
CONFIG_SCLK=y
```

## nodes/ukamaOS/firmware/at91bootstrap/board/at91sam9rlek/at91sam9rleksd_uboot_defconfig
```kconfig
CONFIG_AT91SAM9RLEK=y
CONFIG_SDCARD=y
CONFIG_DEBUG=y
CONFIG_THUMB=y
CONFIG_SCLK=y
```

## nodes/ukamaOS/firmware/at91bootstrap/board/at91sam9x5ek/at91sam9x5ekdf_uboot_defconfig
```kconfig
CONFIG_AT91SAM9X5EK=y
CONFIG_RAM_128MB=y
# CONFIG_DATAFLASH_RECOVERY is not set
CONFIG_DEBUG=y
CONFIG_THUMB=y
CONFIG_SCLK=y
CONFIG_LOAD_ONE_WIRE=y
```

## nodes/ukamaOS/firmware/at91bootstrap/board/at91sam9x5ek/at91sam9x5eknf_linux_image_defconfig
```kconfig
CONFIG_AT91SAM9X5EK=y
CONFIG_RAM_128MB=y
CONFIG_NANDFLASH=y
# CONFIG_PMECC_AUTO_DETECT is not set
CONFIG_LOAD_LINUX=y
# CONFIG_OF_LIBFDT is not set
CONFIG_DEBUG=y
CONFIG_THUMB=y
```

## nodes/ukamaOS/firmware/at91bootstrap/board/at91sam9x5ek/at91sam9x5eknf_uboot_defconfig
```kconfig
CONFIG_AT91SAM9X5EK=y
CONFIG_RAM_128MB=y
CONFIG_NANDFLASH=y
# CONFIG_PMECC_AUTO_DETECT is not set
CONFIG_IMG_SIZE="0x000b0000"
CONFIG_DEBUG=y
CONFIG_THUMB=y
```

## nodes/ukamaOS/firmware/at91bootstrap/board/at91sam9x5ek/at91sam9x5eksd_linux_image_defconfig
```kconfig
CONFIG_AT91SAM9X5EK=y
CONFIG_RAM_128MB=y
CONFIG_SDCARD=y
CONFIG_LOAD_LINUX=y
# CONFIG_OF_LIBFDT is not set
CONFIG_DEBUG=y
CONFIG_THUMB=y
CONFIG_SCLK=y
```

## nodes/ukamaOS/firmware/at91bootstrap/board/sam9x60_ddr2_sip_eb/sam9x60_ddr2_sip_ebnf_uboot_defconfig
```kconfig
CONFIG_SAM9X60_DDR2_SIP_EB=y
CONFIG_RAM_128MB=y
CONFIG_NANDFLASH=y
# CONFIG_PMECC_AUTO_DETECT is not set
CONFIG_PMECC_CORRECT_BITS_8=y
CONFIG_IMG_SIZE="0x000c0000"
CONFIG_DEBUG=y
CONFIG_THUMB=y
```

## nodes/ukamaOS/firmware/at91bootstrap/board/sam9x60_ddr2_sip_eb/sam9x60_ddr2_sip_ebsd_linux_image_dt_defconfig
```kconfig
CONFIG_SAM9X60_DDR2_SIP_EB=y
CONFIG_RAM_128MB=y
CONFIG_SDCARD=y
CONFIG_LOAD_LINUX=y
CONFIG_IMAGE_NAME="zImage"
CONFIG_DEBUG=y
CONFIG_THUMB=y
```

## nodes/ukamaOS/firmware/at91bootstrap/board/sam9x60_sdr_sip_eb/sam9x60_sdr_sip_ebdf_qspi_uboot_defconfig
```kconfig
CONFIG_SAM9X60_SDR_SIP_EB=y
CONFIG_RAM_8MB=y
CONFIG_SDRAM_16BIT=y
CONFIG_SPI_CLK=50000000
CONFIG_IMG_ADDRESS="0x00040000"
CONFIG_IMG_SIZE="0x000c0000"
CONFIG_DEBUG=y
```

## nodes/ukamaOS/firmware/at91bootstrap/board/sam9x60_sdr_sip_eb/sam9x60_sdr_sip_ebnf_uboot_defconfig
```kconfig
CONFIG_SAM9X60_SDR_SIP_EB=y
CONFIG_RAM_8MB=y
CONFIG_SDRAM_16BIT=y
CONFIG_NANDFLASH=y
# CONFIG_PMECC_AUTO_DETECT is not set
CONFIG_PMECC_CORRECT_BITS_8=y
CONFIG_IMG_SIZE="0x000c0000"
CONFIG_DEBUG=y
CONFIG_THUMB=y
```

## nodes/ukamaOS/firmware/at91bootstrap/board/sam9x60_sdr_sip_eb/sam9x60_sdr_sip_ebsd_linux_image_dt_defconfig
```kconfig
CONFIG_SAM9X60_SDR_SIP_EB=y
CONFIG_RAM_8MB=y
CONFIG_SDRAM_16BIT=y
CONFIG_SDCARD=y
CONFIG_LOAD_LINUX=y
CONFIG_IMAGE_NAME="zImage"
CONFIG_DEBUG=y
CONFIG_THUMB=y
```

## nodes/ukamaOS/firmware/at91bootstrap/board/sam9x60ek/sam9x60ekdf_qspi_linux_image_dt_defconfig
```kconfig
CONFIG_SAM9X60EK=y
CONFIG_RAM_256MB=y
CONFIG_SPI_CLK=50000000
CONFIG_OVERRIDE_CMDLINE=y
CONFIG_IMG_ADDRESS="0x00200000"
CONFIG_OF_OFFSET="0x00180000"
CONFIG_LOAD_LINUX=y
CONFIG_JUMP_ADDR="0x26F00000"
CONFIG_DEBUG=y
```

## nodes/ukamaOS/firmware/at91bootstrap/board/sam9x60ek/sam9x60eknf_uboot_defconfig
```kconfig
CONFIG_SAM9X60EK=y
CONFIG_RAM_256MB=y
CONFIG_NANDFLASH=y
# CONFIG_PMECC_AUTO_DETECT is not set
CONFIG_PMECC_CORRECT_BITS_8=y
CONFIG_IMG_SIZE="0x000c0000"
CONFIG_DEBUG=y
CONFIG_THUMB=y
```

## nodes/ukamaOS/firmware/at91bootstrap/board/sam9x60ek/sam9x60eksd_linux_image_dt_defconfig
```kconfig
CONFIG_SAM9X60EK=y
CONFIG_RAM_256MB=y
CONFIG_SDCARD=y
CONFIG_LOAD_LINUX=y
CONFIG_IMAGE_NAME="zImage"
CONFIG_DEBUG=y
CONFIG_THUMB=y
```

## nodes/ukamaOS/firmware/at91bootstrap/board/sama5d27_som1_ek/sama5d27_som1_ekqspi_linux_image_dt_defconfig
```kconfig
CONFIG_SAMA5D27_SOM1_EK=y
CONFIG_RAM_128MB=y
CONFIG_SPI_CLK=66000000
CONFIG_QSPI=y
CONFIG_QSPI_BUS1=y
CONFIG_QSPI1_IOSET_2=y
CONFIG_LOAD_LINUX=y
CONFIG_OVERRIDE_CMDLINE=y
CONFIG_IMG_ADDRESS="0xe0000"
CONFIG_OF_OFFSET="0xc0000"
CONFIG_DEBUG=y
# CONFIG_ENTER_NWD is not set
```

## nodes/ukamaOS/firmware/at91bootstrap/board/sama5d27_som1_ek/sama5d27_som1_ekqspi_uboot_defconfig
```kconfig
CONFIG_SAMA5D27_SOM1_EK=y
CONFIG_RAM_128MB=y
CONFIG_SPI_CLK=66000000
CONFIG_QSPI=y
CONFIG_QSPI_BUS1=y
CONFIG_QSPI1_IOSET_2=y
CONFIG_IMG_ADDRESS="0x00040000"
CONFIG_JUMP_ADDR="0x23f00000"
CONFIG_DEBUG=y
# CONFIG_ENTER_NWD is not set
```

## nodes/ukamaOS/firmware/at91bootstrap/board/sama5d27_som1_ek/sama5d27_som1_eksd_linux_image_dt_defconfig
```kconfig
CONFIG_SAMA5D27_SOM1_EK=y
CONFIG_RAM_128MB=y
CONFIG_SDCARD=y
CONFIG_LOAD_LINUX=y
CONFIG_OVERRIDE_CMDLINE=y
CONFIG_IMAGE_NAME="zImage"
CONFIG_DEBUG=y
# CONFIG_ENTER_NWD is not set
```
