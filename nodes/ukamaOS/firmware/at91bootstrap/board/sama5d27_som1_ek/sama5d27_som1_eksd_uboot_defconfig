## nodes/ukamaOS/firmware/at91bootstrap/board/sama5d27_som1_ek/sama5d27_som1_eksd_uboot_defconfig
```kconfig
CONFIG_SAMA5D27_SOM1_EK=y
CONFIG_RAM_128MB=y
CONFIG_SDCARD=y
CONFIG_JUMP_ADDR="0x23f00000"
CONFIG_DEBUG=y
# CONFIG_ENTER_NWD is not set
```

## nodes/ukamaOS/firmware/at91bootstrap/board/sama5d27_wlsom1_ek/sama5d27_wlsom1_ekdf_qspi_linux_image_dt_defconfig
```kconfig
CONFIG_SAMA5D27_WLSOM1_EK=y
CONFIG_MCK_BYPASS=y
CONFIG_RAM_256MB=y
CONFIG_LPDDR2=y
CONFIG_SPI_CLK=50000000
CONFIG_QSPI=y
CONFIG_QSPI_BUS1=y
CONFIG_QSPI1_IOSET_2=y
CONFIG_LOAD_LINUX=y
CONFIG_OVERRIDE_CMDLINE=y
CONFIG_IMG_ADDRESS="0x00200000"
CONFIG_OF_OFFSET="0x00180000"
CONFIG_DEBUG=y
# CONFIG_ENTER_NWD is not set
```

## nodes/ukamaOS/firmware/at91bootstrap/board/sama5d27_wlsom1_ek/sama5d27_wlsom1_ekdf_qspi_uboot_defconfig
```kconfig
CONFIG_SAMA5D27_WLSOM1_EK=y
CONFIG_MCK_BYPASS=y
CONFIG_RAM_256MB=y
CONFIG_LPDDR2=y
CONFIG_SPI_CLK=50000000
CONFIG_QSPI=y
CONFIG_QSPI_BUS1=y
CONFIG_QSPI1_IOSET_2=y
CONFIG_IMG_ADDRESS="0x00040000"
CONFIG_IMG_SIZE="0x000c0000"
CONFIG_DEBUG=y
# CONFIG_ENTER_NWD is not set
```

## nodes/ukamaOS/firmware/at91bootstrap/board/sama5d27_wlsom1_ek/sama5d27_wlsom1_eksd_linux_image_dt_defconfig
```kconfig
CONFIG_SAMA5D27_WLSOM1_EK=y
CONFIG_MCK_BYPASS=y
CONFIG_RAM_256MB=y
CONFIG_LPDDR2=y
CONFIG_SDCARD=y
CONFIG_LOAD_LINUX=y
CONFIG_OVERRIDE_CMDLINE=y
CONFIG_DEBUG=y
# CONFIG_ENTER_NWD is not set
```

## nodes/ukamaOS/firmware/at91bootstrap/board/sama5d2_lpddr2sip_vb/sama5d2_lpddr2sip_vbsd_linux_image_dt_defconfig
```kconfig
CONFIG_SAMA5D2_LPDDR2SIP_VB=y
CONFIG_RAM_256MB=y
CONFIG_LPDDR2=y
CONFIG_SDHC1=y
CONFIG_LOAD_LINUX=y
CONFIG_OVERRIDE_CMDLINE=y
CONFIG_IMAGE_NAME="zImage"
CONFIG_DEBUG=y
# CONFIG_ENTER_NWD is not set
```

## nodes/ukamaOS/firmware/at91bootstrap/board/sama5d2_ptc_ek/sama5d2_ptc_eknf_uboot_defconfig
```kconfig
CONFIG_SAMA5D2_PTC_EK=y
CONFIG_RAM_512MB=y
CONFIG_DDR2=y
CONFIG_NANDFLASH=y
CONFIG_DEBUG=y
# CONFIG_ENTER_NWD is not set
```

## nodes/ukamaOS/firmware/at91bootstrap/board/sama5d2_xplained/sama5d2_xplainedsd_secure_linux_image_dt_defconfig
```kconfig
CONFIG_SAMA5D2_XPLAINED=y
CONFIG_RAM_512MB=y
CONFIG_DDR3=y
CONFIG_SDCARD=y
CONFIG_LOAD_LINUX=y
CONFIG_IMAGE_NAME="zImage.cip"
CONFIG_JUMP_ADDR="0x26F00000"
CONFIG_SDHC1=y
CONFIG_DEBUG=y
# CONFIG_ENTER_NWD is not set
CONFIG_ACT8865_SET_VOLTAGE=y
# CONFIG_DISABLE_ACT8865_I2C is not set
CONFIG_SUSPEND_ACT8945A_CHARGER=y
CONFIG_AES=y
CONFIG_SECURE=y
CONFIG_AES_KEY_SIZE_256=y
```

## nodes/ukamaOS/firmware/at91bootstrap/board/sama5d3_xplained/sama5d3_xplainedsd_linux_image_dt_defconfig
```kconfig
CONFIG_SAMA5D3_XPLAINED=y
CONFIG_CPU_CLK_528MHZ=y
CONFIG_RAM_256MB=y
CONFIG_SDCARD=y
CONFIG_LOAD_LINUX=y
CONFIG_OVERRIDE_CMDLINE=y
CONFIG_IMAGE_NAME="zImage"
CONFIG_DEBUG=y
```

## nodes/ukamaOS/firmware/at91bootstrap/board/sama5d3x_cmp/sama5d3x_cmpnf_uboot_defconfig
```kconfig
CONFIG_SAMA5D3X_CMP=y
CONFIG_RAM_512MB=y
CONFIG_LPDDR2=y
CONFIG_NANDFLASH=y
CONFIG_DEBUG=y
CONFIG_SCLK=y
```

## nodes/ukamaOS/firmware/at91bootstrap/board/sama5d3xek/sama5d3xekdf_uboot_defconfig
```kconfig
CONFIG_SAMA5D3XEK=y
CONFIG_CPU_CLK_528MHZ=y
CONFIG_RAM_512MB=y
CONFIG_DEBUG=y
CONFIG_SCLK=y
CONFIG_LOAD_ONE_WIRE=y
```

## nodes/ukamaOS/firmware/at91bootstrap/board/sama5d3xek/sama5d3xeknf_linux_image_dt_defconfig
```kconfig
CONFIG_SAMA5D3XEK=y
CONFIG_CPU_CLK_528MHZ=y
CONFIG_RAM_512MB=y
CONFIG_NANDFLASH=y
# CONFIG_PMECC_AUTO_DETECT is not set
CONFIG_PMECC_CORRECT_BITS_4=y
CONFIG_LOAD_LINUX=y
CONFIG_DEBUG=y
CONFIG_SCLK=y
CONFIG_LOAD_ONE_WIRE=y
```

## nodes/ukamaOS/firmware/at91bootstrap/board/sama5d3xek/sama5d3xeknor_linux_image_dt_defconfig
```kconfig
CONFIG_SAMA5D3XEK=y
CONFIG_CPU_CLK_528MHZ=y
CONFIG_RAM_512MB=y
CONFIG_FLASH=y
CONFIG_LOAD_LINUX=y
CONFIG_LINUX_KERNEL_ARG_STRING="mem=512M console=ttyS0,115200 mtdparts=atmel_nand:8M(bootstrap/kernel)ro,-(rootfs) rw rootfstype=ubifs ubi.mtd=1 root=ubi0:rootfs"
CONFIG_DEBUG=y
```

## nodes/ukamaOS/firmware/at91bootstrap/board/sama5d3xek/sama5d3xeknor_uboot_defconfig
```kconfig
CONFIG_SAMA5D3XEK=y
CONFIG_CPU_CLK_528MHZ=y
CONFIG_RAM_512MB=y
CONFIG_FLASH=y
CONFIG_IMG_ADDRESS="0x00020000"
CONFIG_DEBUG=y
CONFIG_SCLK=y
CONFIG_LOAD_ONE_WIRE=y
```

## nodes/ukamaOS/firmware/at91bootstrap/board/sama5d4_xplained/sama5d4_xplainednf_uboot_secure_defconfig
```kconfig
CONFIG_SAMA5D4_XPLAINED=y
CONFIG_CPU_CLK_600MHZ=y
CONFIG_RAM_512MB=y
CONFIG_NANDFLASH=y
CONFIG_DEBUG=y
CONFIG_SCLK=y
# CONFIG_ENTER_NWD is not set
CONFIG_PM_EXTERNAL_DEVICES=y
CONFIG_MAC0_PHY=y
CONFIG_HDMI=y
CONFIG_ACT8865=y
CONFIG_PMIC_ON_TWI3=y
CONFIG_LOAD_EEPROM=y
```

## nodes/ukamaOS/firmware/at91bootstrap/board/sama5d4ek/sama5d4ekdf_uboot_secure_defconfig
```kconfig
CONFIG_SAMA5D4EK=y
CONFIG_CPU_CLK_528MHZ=y
CONFIG_BUS_SPEED_176MHZ=y
CONFIG_RAM_512MB=y
CONFIG_DEBUG=y
CONFIG_SCLK=y
# CONFIG_ENTER_NWD is not set
CONFIG_PM_EXTERNAL_DEVICES=y
CONFIG_MAC0_PHY=y
CONFIG_MAC1_PHY=y
CONFIG_HDMI=y
CONFIG_WM8904=y
CONFIG_ACT8865=y
CONFIG_LOAD_ONE_WIRE=y
```

## nodes/ukamaOS/firmware/at91bootstrap/board/sama5d4ek/sama5d4eksd_uboot_secure_defconfig
```kconfig
CONFIG_SAMA5D4EK=y
CONFIG_CPU_CLK_528MHZ=y
CONFIG_RAM_512MB=y
CONFIG_SDCARD=y
CONFIG_AT91_MCI1=y
CONFIG_DEBUG=y
# CONFIG_ENTER_NWD is not set
```

## nodes/ukamaOS/firmware/at91bootstrap/contrib/board/acme/at91sam9x5_arietta/arietta-128m_defconfig
```kconfig
CONFIG_AT91SAM9X5_ARIETTA=y
CONFIG_RAM_128MB=y
CONFIG_SDCARD=y
CONFIG_LOAD_LINUX=y
CONFIG_OVERRIDE_CMDLINE=y
CONFIG_IMAGE_NAME="zImage"
CONFIG_DEBUG=y
CONFIG_THUMB=y
# CONFIG_LOAD_ONE_WIRE is not set
```

## nodes/ukamaOS/firmware/at91bootstrap/contrib/board/acme/at91sam9x5_arietta/arietta-256m-uboot_defconfig
```kconfig
CONFIG_AT91SAM9X5_ARIETTA=y
CONFIG_RAM_256MB=y
CONFIG_SDCARD=y
CONFIG_DEBUG=y
CONFIG_THUMB=y
# CONFIG_SCLK is not set
# CONFIG_LOAD_ONE_WIRE is not set
```

## nodes/ukamaOS/firmware/at91bootstrap/contrib/board/acme/sama5d3_acqua/acqua-512m_defconfig
```kconfig
CONFIG_SAMA5D3_ACQUA=y
CONFIG_CPU_CLK_528MHZ=y
CONFIG_RAM_512MB=y
CONFIG_SDCARD=y
CONFIG_LOAD_LINUX=y
CONFIG_OVERRIDE_CMDLINE=y
CONFIG_IMAGE_NAME="zImage"
CONFIG_DEBUG=y
CONFIG_SCLK=y
CONFIG_MAC0_PHY=y
CONFIG_ACT8865=y
CONFIG_AUTOCONFIG_TWI_BUS=y
```

## nodes/ukamaOS/firmware/at91bootstrap/contrib/board/l+g/vinco/vincodf_uboot_defconfig
```kconfig
CONFIG_VINCO=y
CONFIG_CPU_CLK_600MHZ=y
CONFIG_SPI_CLK=50000000
CONFIG_IMG_ADDRESS="0x20000"
CONFIG_JUMP_ADDR="0x20f00000"
# CONFIG_ENTER_NWD is not set
# CONFIG_AUTOCONFIG_TWI_BUS is not set
```

## nodes/ukamaOS/firmware/at91bootstrap/contrib/board/mini-box/pico_sam9g45/pico_sam9g45_linux_image_defconfig
```kconfig
CONFIG_PICOSAM9G45=y
CONFIG_SDCARD=y
CONFIG_LOAD_LINUX=y
CONFIG_OVERRIDE_CMDLINE=y
CONFIG_LINUX_KERNEL_ARG_STRING="mem=128M@0x20000000 mem=128M@0x70000000 console=ttyS0,115200 root=/dev/mmcblk0p2 rootdelay=2"
# CONFIG_OF_LIBFDT is not set
CONFIG_DEBUG=y
CONFIG_THUMB=y
CONFIG_SCLK=y
CONFIG_RAM_128MB=y
CONFIG_OVERRIDE_MACH_TYPE=y
CONFIG_CUSTOM_MACH_TYPE="3838"
CONFIG_MEM_BANK="0x70000000"
CONFIG_MEM_BANK2="0x20000000"
CONFIG_JUMP_ADDR="0x72000000"
```

## nodes/ukamaOS/firmware/at91bootstrap/contrib/board/mini-box/pico_sam9g45/pico_sam9g45_uboot_defconfig
```kconfig
CONFIG_PICOSAM9G45=y
CONFIG_SDCARD=y
CONFIG_DEBUG=y
CONFIG_THUMB=y
CONFIG_SCLK=y
CONFIG_RAM_128MB=y
```

## nodes/ukamaOS/firmware/coreboot/src/mainboard/ukama/comv1/Kconfig.name
```kconfig
config BOARD_UKAMA_COMV1
	bool "Ukama ComV1 (X86 Compute)"
	select BOARD_UKAMA_BASEBOARD_COMV1

config BOARD_UKAMA_SUPABRCKV1
	bool "Ukama Supabrck V1 (BRCK)"
	select BOARD_UKAMA_BASEBOARD_COMV1
```

## nodes/ukamaOS/firmware/uboot/board/atmel/sama5d27_ukama_anode/Kconfig
```kconfig
if TARGET_SAMA5D27_UKAMA_ANODE

config SYS_BOARD
	default "sama5d27_ukama_anode"

config SYS_VENDOR
	default "atmel"

config SYS_SOC
	default "at91"

config SYS_CONFIG_NAME
	default "sama5d27_ukama_anode"

endif
```
