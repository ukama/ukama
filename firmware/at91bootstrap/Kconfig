## nodes/ukamaOS/firmware/at91bootstrap/board/at91sam9260ek/at91sam9260eknf_uboot_defconfig
```kconfig
CONFIG_NANDFLASH=y
# CONFIG_ONFI_DETECT_SUPPORT is not set
# CONFIG_USE_ON_DIE_ECC_SUPPORT is not set
CONFIG_THUMB=y
```

## nodes/ukamaOS/firmware/at91bootstrap/board/at91sam9g20ek/at91sam9g20ekdf_linux_image_defconfig
```kconfig
CONFIG_AT91SAM9G20EK=y
CONFIG_SPI_BOOT_CS1=y
CONFIG_LOAD_LINUX=y
# CONFIG_OF_LIBFDT is not set
CONFIG_DEBUG=y
CONFIG_THUMB=y
```
