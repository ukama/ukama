## firmware/at91bootstrap/board/at91sam9263ek/at91sam9263eknf_linux_image_dt_defconfig
```kconfig
CONFIG_AT91SAM9263EK=y
CONFIG_CRYSTAL_16_36766MHZ=y
CONFIG_PSRAM=y
CONFIG_NANDFLASH=y
CONFIG_LOAD_LINUX=y
CONFIG_DEBUG=y
CONFIG_THUMB=y
```

## firmware/at91bootstrap/board/at91sam9m10g45ek/at91sam9m10g45eksd_linux_image_dt_defconfig
```kconfig
CONFIG_AT91SAM9M10G45EK=y
CONFIG_SDCARD=y
CONFIG_LOAD_LINUX=y
CONFIG_LINUX_KERNEL_ARG_STRING="mem=64M console=ttyS0,115200 root=/dev/mmcblk0p2 rootdelay=2"
CONFIG_DEBUG=y
CONFIG_THUMB=y
CONFIG_SCLK=y
```

## firmware/at91bootstrap/board/at91sam9n12ek/at91sam9n12eksd_linux_image_defconfig
```kconfig
CONFIG_AT91SAM9N12EK=y
CONFIG_RAM_128MB=y
CONFIG_SDCARD=y
CONFIG_LOAD_LINUX=y
# CONFIG_OF_LIBFDT is not set
CONFIG_DEBUG=y
CONFIG_THUMB=y
CONFIG_SCLK=y
```

## firmware/at91bootstrap/board/at91sam9x5ek/at91sam9x5eknf_linux_image_dt_defconfig
```kconfig
CONFIG_AT91SAM9X5EK=y
CONFIG_RAM_128MB=y
CONFIG_NANDFLASH=y
# CONFIG_PMECC_AUTO_DETECT is not set
# CONFIG_NANDFLASH_RECOVERY is not set
CONFIG_LOAD_LINUX=y
CONFIG_DEBUG=y
CONFIG_THUMB=y
CONFIG_SCLK=y
CONFIG_LOAD_ONE_WIRE=y
```

## firmware/at91bootstrap/board/sam9x60ek/sam9x60eksd_uboot_defconfig
```kconfig
CONFIG_SAM9X60EK=y
CONFIG_RAM_256MB=y
CONFIG_SDCARD=y
CONFIG_DEBUG=y
CONFIG_THUMB=y
```

## firmware/at91bootstrap/board/sama5d27_wlsom1_ek/sama5d27_wlsom1_ek-bsrsd_uboot_defconfig
```kconfig
CONFIG_SAMA5D27_WLSOM1_EK=y
CONFIG_MCK_BYPASS=y
CONFIG_RAM_256MB=y
CONFIG_LPDDR2=y
CONFIG_SDCARD=y
CONFIG_DEBUG=y
# CONFIG_ENTER_NWD is not set
CONFIG_BACKUP_MODE=y
```

## firmware/at91bootstrap/board/sama5d2_xplained/sama5d2_xplained-bsrsd_uboot_defconfig
```kconfig
CONFIG_SAMA5D2_XPLAINED=y
CONFIG_RAM_512MB=y
CONFIG_DDR3=y
CONFIG_SDCARD=y
CONFIG_SDHC1=y
CONFIG_DEBUG=y
# CONFIG_ENTER_NWD is not set
CONFIG_BACKUP_MODE=y
CONFIG_ACT8865_SET_VOLTAGE=y
# CONFIG_DISABLE_ACT8865_I2C is not set
CONFIG_SUSPEND_ACT8945A_CHARGER=y
```

## firmware/at91bootstrap/board/sama5d2_xplained/sama5d2_xplaineddf_qspi_uboot_defconfig
```kconfig
CONFIG_SAMA5D2_XPLAINED=y
CONFIG_RAM_512MB=y
CONFIG_DDR3=y
CONFIG_QSPI=y
CONFIG_QSPI0_IOSET_3=y
CONFIG_QSPI_4B_OPCODES=y
CONFIG_IMG_ADDRESS="0x00040000"
CONFIG_DEBUG=y
# CONFIG_ENTER_NWD is not set
CONFIG_ACT8865_SET_VOLTAGE=y
# CONFIG_DISABLE_ACT8865_I2C is not set
CONFIG_SUSPEND_ACT8945A_CHARGER=y
```

## firmware/at91bootstrap/board/sama5d2_xplained/sama5d2_xplainedemmc_uboot_defconfig
```kconfig
CONFIG_SAMA5D2_XPLAINED=y
CONFIG_RAM_512MB=y
CONFIG_DDR3=y
CONFIG_SDCARD=y
CONFIG_DEBUG=y
# CONFIG_ENTER_NWD is not set
CONFIG_ACT8865_SET_VOLTAGE=y
# CONFIG_DISABLE_ACT8865_I2C is not set
CONFIG_SUSPEND_ACT8945A_CHARGER=y
```

## firmware/at91bootstrap/board/sama5d3_xplained/sama5d3_xplainedsd_uboot_defconfig
```kconfig
CONFIG_SAMA5D3_XPLAINED=y
CONFIG_CPU_CLK_528MHZ=y
CONFIG_RAM_256MB=y
CONFIG_SDCARD=y
CONFIG_DEBUG=y
CONFIG_SCLK=y
CONFIG_PM_EXTERNAL_DEVICES=y
CONFIG_MAC0_PHY=y
CONFIG_MAC1_PHY=y
CONFIG_ACT8865=y
CONFIG_PMIC_ON_TWI1=y
```

## firmware/at91bootstrap/board/sama5d3xek/sama5d3xeksd_android_image_dt_defconfig
```kconfig
CONFIG_SAMA5D3XEK=y
CONFIG_CPU_CLK_528MHZ=y
CONFIG_RAM_512MB=y
CONFIG_SDCARD=y
CONFIG_LOAD_ANDROID=y
CONFIG_OVERRIDE_CMDLINE=y
CONFIG_DEBUG=y
```

## firmware/at91bootstrap/contrib/board/axentia/sama5d3_linea/linea-wd_defconfig
```kconfig
CONFIG_SAMA5D3_LINEA=y
CONFIG_CPU_CLK_528MHZ=y
CONFIG_LPDDR1=y
CONFIG_NANDFLASH=y
# CONFIG_PMECC_AUTO_DETECT is not set
CONFIG_PMECC_CORRECT_BITS_4=y
CONFIG_DEBUG=y
# CONFIG_DISABLE_WATCHDOG is not set
CONFIG_SCLK=y
# CONFIG_LOAD_ONE_WIRE is not set
```

## firmware/at91bootstrap/contrib/board/mini-box/pico_sam9g45/pico_sam9g45_linux_image_dt_defconfig
```kconfig
CONFIG_PICOSAM9G45=y
CONFIG_SDCARD=y
CONFIG_LOAD_LINUX=y
CONFIG_OVERRIDE_CMDLINE=y
CONFIG_LINUX_KERNEL_ARG_STRING="console=ttyS0,115200 root=/dev/mmcblk0p2 rootdelay=2"
CONFIG_DEBUG=y
CONFIG_THUMB=y
CONFIG_SCLK=y
CONFIG_RAM_128MB=y
```
